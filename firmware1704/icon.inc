;The TashTwenty logo in the form of a 32x32 bitmap icon with mask
;................................................................
;................................................................
;................................................................
;................................................................
;................................................................
;................................................................
;................................................................
;................................................................
;............................##################..######..........
;........................######            ########  ####........
;......................####                        ######........
;....................####    ####  ##            ########........
;....................##  ######  ####  ####  ##########..........
;....................########    ##    ####  ########............
;......................######  ####    ####  ####................
;........................##    ####    ####  ####................
;........................##    ####    ####  ####................
;........................##      ##    ####  ####................
;........................##      ##  ######  ##########..........
;........................####      ########  ######  ####........
;..##########################        ######  ##    ############..
;##                        ####                  ########      ##
;##                        ########          ##########        ##
;##                          ########################          ##
;##                              ################              ##
;##                                                            ##
;##      ####                                                  ##
;##                                                            ##
;##                                                            ##
;..############################################################..
;................................................................
;................................................................
	retlw	0x00
	retlw	0x00
	retlw	0x00
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	retlw	0x00
