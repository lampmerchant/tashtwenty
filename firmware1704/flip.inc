;LUT for flipping bytes left to right for use with USART as IWM transmitter
	retlw	B'00000000'
	retlw	B'10000000'
	retlw	B'01000000'
	retlw	B'11000000'
	retlw	B'00100000'
	retlw	B'10100000'
	retlw	B'01100000'
	retlw	B'11100000'
	retlw	B'00010000'
	retlw	B'10010000'
	retlw	B'01010000'
	retlw	B'11010000'
	retlw	B'00110000'
	retlw	B'10110000'
	retlw	B'01110000'
	retlw	B'11110000'
	retlw	B'00001000'
	retlw	B'10001000'
	retlw	B'01001000'
	retlw	B'11001000'
	retlw	B'00101000'
	retlw	B'10101000'
	retlw	B'01101000'
	retlw	B'11101000'
	retlw	B'00011000'
	retlw	B'10011000'
	retlw	B'01011000'
	retlw	B'11011000'
	retlw	B'00111000'
	retlw	B'10111000'
	retlw	B'01111000'
	retlw	B'11111000'
	retlw	B'00000100'
	retlw	B'10000100'
	retlw	B'01000100'
	retlw	B'11000100'
	retlw	B'00100100'
	retlw	B'10100100'
	retlw	B'01100100'
	retlw	B'11100100'
	retlw	B'00010100'
	retlw	B'10010100'
	retlw	B'01010100'
	retlw	B'11010100'
	retlw	B'00110100'
	retlw	B'10110100'
	retlw	B'01110100'
	retlw	B'11110100'
	retlw	B'00001100'
	retlw	B'10001100'
	retlw	B'01001100'
	retlw	B'11001100'
	retlw	B'00101100'
	retlw	B'10101100'
	retlw	B'01101100'
	retlw	B'11101100'
	retlw	B'00011100'
	retlw	B'10011100'
	retlw	B'01011100'
	retlw	B'11011100'
	retlw	B'00111100'
	retlw	B'10111100'
	retlw	B'01111100'
	retlw	B'11111100'
	retlw	B'00000010'
	retlw	B'10000010'
	retlw	B'01000010'
	retlw	B'11000010'
	retlw	B'00100010'
	retlw	B'10100010'
	retlw	B'01100010'
	retlw	B'11100010'
	retlw	B'00010010'
	retlw	B'10010010'
	retlw	B'01010010'
	retlw	B'11010010'
	retlw	B'00110010'
	retlw	B'10110010'
	retlw	B'01110010'
	retlw	B'11110010'
	retlw	B'00001010'
	retlw	B'10001010'
	retlw	B'01001010'
	retlw	B'11001010'
	retlw	B'00101010'
	retlw	B'10101010'
	retlw	B'01101010'
	retlw	B'11101010'
	retlw	B'00011010'
	retlw	B'10011010'
	retlw	B'01011010'
	retlw	B'11011010'
	retlw	B'00111010'
	retlw	B'10111010'
	retlw	B'01111010'
	retlw	B'11111010'
	retlw	B'00000110'
	retlw	B'10000110'
	retlw	B'01000110'
	retlw	B'11000110'
	retlw	B'00100110'
	retlw	B'10100110'
	retlw	B'01100110'
	retlw	B'11100110'
	retlw	B'00010110'
	retlw	B'10010110'
	retlw	B'01010110'
	retlw	B'11010110'
	retlw	B'00110110'
	retlw	B'10110110'
	retlw	B'01110110'
	retlw	B'11110110'
	retlw	B'00001110'
	retlw	B'10001110'
	retlw	B'01001110'
	retlw	B'11001110'
	retlw	B'00101110'
	retlw	B'10101110'
	retlw	B'01101110'
	retlw	B'11101110'
	retlw	B'00011110'
	retlw	B'10011110'
	retlw	B'01011110'
	retlw	B'11011110'
	retlw	B'00111110'
	retlw	B'10111110'
	retlw	B'01111110'
	retlw	B'11111110'
	retlw	B'00000001'
	retlw	B'10000001'
	retlw	B'01000001'
	retlw	B'11000001'
	retlw	B'00100001'
	retlw	B'10100001'
	retlw	B'01100001'
	retlw	B'11100001'
	retlw	B'00010001'
	retlw	B'10010001'
	retlw	B'01010001'
	retlw	B'11010001'
	retlw	B'00110001'
	retlw	B'10110001'
	retlw	B'01110001'
	retlw	B'11110001'
	retlw	B'00001001'
	retlw	B'10001001'
	retlw	B'01001001'
	retlw	B'11001001'
	retlw	B'00101001'
	retlw	B'10101001'
	retlw	B'01101001'
	retlw	B'11101001'
	retlw	B'00011001'
	retlw	B'10011001'
	retlw	B'01011001'
	retlw	B'11011001'
	retlw	B'00111001'
	retlw	B'10111001'
	retlw	B'01111001'
	retlw	B'11111001'
	retlw	B'00000101'
	retlw	B'10000101'
	retlw	B'01000101'
	retlw	B'11000101'
	retlw	B'00100101'
	retlw	B'10100101'
	retlw	B'01100101'
	retlw	B'11100101'
	retlw	B'00010101'
	retlw	B'10010101'
	retlw	B'01010101'
	retlw	B'11010101'
	retlw	B'00110101'
	retlw	B'10110101'
	retlw	B'01110101'
	retlw	B'11110101'
	retlw	B'00001101'
	retlw	B'10001101'
	retlw	B'01001101'
	retlw	B'11001101'
	retlw	B'00101101'
	retlw	B'10101101'
	retlw	B'01101101'
	retlw	B'11101101'
	retlw	B'00011101'
	retlw	B'10011101'
	retlw	B'01011101'
	retlw	B'11011101'
	retlw	B'00111101'
	retlw	B'10111101'
	retlw	B'01111101'
	retlw	B'11111101'
	retlw	B'00000011'
	retlw	B'10000011'
	retlw	B'01000011'
	retlw	B'11000011'
	retlw	B'00100011'
	retlw	B'10100011'
	retlw	B'01100011'
	retlw	B'11100011'
	retlw	B'00010011'
	retlw	B'10010011'
	retlw	B'01010011'
	retlw	B'11010011'
	retlw	B'00110011'
	retlw	B'10110011'
	retlw	B'01110011'
	retlw	B'11110011'
	retlw	B'00001011'
	retlw	B'10001011'
	retlw	B'01001011'
	retlw	B'11001011'
	retlw	B'00101011'
	retlw	B'10101011'
	retlw	B'01101011'
	retlw	B'11101011'
	retlw	B'00011011'
	retlw	B'10011011'
	retlw	B'01011011'
	retlw	B'11011011'
	retlw	B'00111011'
	retlw	B'10111011'
	retlw	B'01111011'
	retlw	B'11111011'
	retlw	B'00000111'
	retlw	B'10000111'
	retlw	B'01000111'
	retlw	B'11000111'
	retlw	B'00100111'
	retlw	B'10100111'
	retlw	B'01100111'
	retlw	B'11100111'
	retlw	B'00010111'
	retlw	B'10010111'
	retlw	B'01010111'
	retlw	B'11010111'
	retlw	B'00110111'
	retlw	B'10110111'
	retlw	B'01110111'
	retlw	B'11110111'
	retlw	B'00001111'
	retlw	B'10001111'
	retlw	B'01001111'
	retlw	B'11001111'
	retlw	B'00101111'
	retlw	B'10101111'
	retlw	B'01101111'
	retlw	B'11101111'
	retlw	B'00011111'
	retlw	B'10011111'
	retlw	B'01011111'
	retlw	B'11011111'
	retlw	B'00111111'
	retlw	B'10111111'
	retlw	B'01111111'
	retlw	B'11111111'
